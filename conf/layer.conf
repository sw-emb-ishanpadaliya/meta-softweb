## conf/layer.conf
```bitbake
# Copyright (C) 2022 AVNET Embedded, MSC Technologies GmbH

# We have a conf and classes directory, add to BBPATH
BBPATH .= ":${LAYERDIR}"

# We have a packages directory, add to BBFILES
BBFILES += "${LAYERDIR}/recipes-*/*/*.bb ${LAYERDIR}/recipes-*/*/*.bbappend"

BBFILE_COLLECTIONS += "softweb"
BBFILE_PATTERN_softweb:= "^${LAYERDIR}/"
BBFILE_PRIORITY_softweb = "30"

# This should only be incremented on significant changes that will
# cause compatibility issues with other layers
LAYERVERSION_softweb = "1"

LAYERDEPENDS_softweb = "meta-ti"
LAYERSERIES_COMPAT_softweb = "dunfell"

#
BBFILES += "${@' '.join('${LAYERDIR}/dynamic-layers/%s/recipes*/*/*.bbappend' % layer \
               for layer in BBFILE_COLLECTIONS.split())}"
BBFILES += "${@' '.join('${LAYERDIR}/dynamic-layers/%s/recipes*/*/*.bb' % layer \
               for layer in BBFILE_COLLECTIONS.split())}"

# This is to support .bbappend files for recipes from meta-msc-ldk-lxqt and
# meta-msc-ldk-hwtests even when there is no msc-ldk-lxqt or msc-ldk-hwtests
# layer.
# Because of priority 1 it's .bb files will be overwritten by meta-msc-ldk-lxqt
# and meta-msc-ldk-hwtests respectively.
BBFILES += "${LAYERDIR}/.dummy-recipes-*/*/*.bb"
BBFILE_COLLECTIONS += "softweb-dummy-recipes"
BBFILE_PATTERN_softweb-dummy-recipes = "^${LAYERDIR}/.dummy-recipes-*"
BBFILE_PRIORITY_softweb-dummy-recipes = "1"
LAYERSERIES_COMPAT_softweb-dummy-recipes = "dunfell"
```

## conf/machine/sm2s-am6254-k3r5-gp.conf
```bitbake
# Copyright (C) 2022 AVNET Embedded

#@TYPE: Machine
#@NAME: AM62XX (R5F)
#@DESCRIPTION: Machine configuration for the TI AM62xx (R5F core)

#Derived from meta-ti/conf/machine/am62xx-evm-k3r5.conf

MACHINEOVERRIDES =. "am62xx-evm-k3r5-gp:"
require ../../meta-ti.git/conf/machine/include/k3r5.inc

SYSFW_SOC = "am62x"
SYSFW_CONFIG = "evm"
SYSFW_SUFFIX = "gp"

UBOOT_MACHINE = "am62x_evm_r5_defconfig"

SYSFW_TIBOOT3_SYMLINK = ""
SPL_BINARY = ""
UBOOT_BINARY = "u-boot-spl.${UBOOT_SUFFIX}"
UBOOT_IMAGE = "u-boot-r5spl-gp-${MAINMACHINE}-${PV}-${PR}.${UBOOT_SUFFIX}"
UBOOT_SYMLINK = "u-boot-r5spl-gp.${UBOOT_SUFFIX}"
```
